// SPDX-License-Identifier: (GPL-2.0+ OR MIT)
//
// Copyright 2022 Prodrive Technologies

/*
 * This model description provides a working base for the i.MX8MPlus building block. It delivers a working DTB
 * with all functionality of the building block itself and nothing more. It provides a starting point for
 * product development, as well as a working DTB for _all_ products using the building block.
 */

/dts-v1/;

// Get the building block
#include "imx8mplus-v1/imx8mp-bb-v1.dtsi"

/ {
	model = "Prodrive Technologies i.MX8MPlus building block base";
	compatible = "pdt,imx8mp-ptic-base" , "fsl,imx8mp";
};
